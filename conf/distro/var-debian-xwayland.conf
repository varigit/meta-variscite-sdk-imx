## conf/distro/var-debian-xwayland.conf
```bitbake
include conf/distro/fsl-imx-xwayland.conf

DISTRO = "var-debian-xwayland"

DISTRO_NAME = "Variscite Debian XWayland"
DISTRO_VERSION = "1.0"
SDK_VENDOR = "-fslbsp"

TARGET_VENDOR = "-fsl"

SDK_NAME_PREFIX = "${DISTRO}"
SDK_NAME = "${DISTRO}-${TCLIBC}-${SDK_ARCH}-${TUNE_PKGARCH}"

POKY_DEFAULT_DISTRO_FEATURES:remove = " ptest"
DISTRO_FEATURES_DEFAULT:append = " benchmark vfat ext2 mtd \
    perl python usbhost virtualization pam polkit"

# disable network check to support offline build with sdk iso
CONNECTIVITY_CHECK_URIS = ""

# whiteliste restricted license
LICENSE_FLAGS_ACCEPTED = "non-commercial_netperf commercial_lame"

# Override preferred version for imx-gpu-viv in meta-nxp-desktop layer.conf due to problems
PREFERRED_VERSION_imx-gpu-viv = ""
PREFERRED_VERSION_imx-gpu-g2d = "${IMX_GPU_VERSION}"
PREFERRED_VERSION_libgpuperfcnt = "${IMX_GPU_VERSION}"
PREFERRED_VERSION_isp-imx:mx8mp-nxp-bsp = "4.2.2.23.0d"
PREFERRED_VERSION_imx-vpu-hantro-vc:mx8mp-nxp-bsp = "1.9.1.1d"
PREFERRED_VERSION_imx-dpu-g2d ?= "2.1.10d"

# Having some problems with i.MX OpenCV, which is brought in by
# gstreamer1.0-plugins-bad, so disable it
PACKAGECONFIG:remove:pn-gstreamer1.0-plugins-bad = "opencv"

BBMASK += "meta-nxp-desktop/recipes-fsl/packagegroups/packagegroup-fsl-tools-extended.bbappend"
BBMASK += "meta-nxp-desktop/recipes-fsl/images/fsl-image-mfgtool.bbappend"
BBMASK += "meta-nxp-desktop/recipes-core/udev/udev-extraconf_%.bbappend"

# Some presets for var-recovery-image target
INSTALL_SCRIPT_NAME = "install_debian.sh"
VAR_RECOVERY_IMAGES_TARGET_PATH = "/opt/images/Debian"
VAR_RECOVERY_SD_IMAGE = "dynamic-layers/var-debian/recipes-var/images/var-image-debian.bb"
VAR_RECOVERY_TARGET_ROOTFS = "var-image-debian"

VAR_SWUPDATE_TARGET_IMAGE ?= "${VAR_RECOVERY_TARGET_ROOTFS}"
```

## conf/layer.conf
```bitbake
# We have a conf and classes directory, add to BBPATH
BBPATH .= ":${LAYERDIR}"

# We have a packages directory, add to BBFILES
BBFILES += "${LAYERDIR}/recipes-*/*/*.bb \
            ${LAYERDIR}/recipes-*/*/*.bbappend"

BBFILE_COLLECTIONS += "variscite-sdk"
BBFILE_PATTERN_variscite-sdk := "^${LAYERDIR}/"
BBFILE_PRIORITY_variscite-sdk = "9"

LAYERSERIES_COMPAT_variscite-sdk = "hardknott"

BBFILES_DYNAMIC += " \
    qt5-layer:${LAYERDIR}/dynamic-layers/qt5-layer/*/*/*.bb \
    qt5-layer:${LAYERDIR}/dynamic-layers/qt5-layer/*/*/*.bbappend \
    \
    swupdate:${LAYERDIR}/dynamic-layers/swupdate/*.bb \
    swupdate:${LAYERDIR}/dynamic-layers/swupdate/*.bbappend \
    \
    virtualization-layer:${LAYERDIR}/dynamic-layers/virtualization/*/*/*.bb \
    virtualization-layer:${LAYERDIR}/dynamic-layers/virtualization/*/*/*.bbappend \
    \
    freescale-distro:${LAYERDIR}/dynamic-layers/freescale-distro/*/*/*.bb \
    freescale-distro:${LAYERDIR}/dynamic-layers/freescale-distro/*/*/*.bbappend \
    \
    fsl-bsp-release:${LAYERDIR}/dynamic-layers/fsl-bsp-release/*/*/*.bb \
    fsl-bsp-release:${LAYERDIR}/dynamic-layers/fsl-bsp-release/*/*/*.bbappend \
"
```

## conf/machine/imx8mm-var-dart-debian.conf
```bitbake
MACHINE="imx8mm-var-dart"
require conf/machine/imx8mm-var-dart.conf

require conf/machine/include/debianbasics.inc
```

## conf/machine/imx8mn-var-som-debian.conf
```bitbake
MACHINE="imx8mn-var-som"
require conf/machine/imx8mn-var-som.conf

require conf/machine/include/debianbasics.inc
```

## conf/machine/imx8mp-var-dart-debian.conf
```bitbake
MACHINE="imx8mp-var-dart"
require conf/machine/imx8mp-var-dart.conf

require conf/machine/include/debianbasics.inc
```

## conf/machine/imx8mq-var-dart-debian.conf
```bitbake
MACHINE="imx8mq-var-dart"
require conf/machine/imx8mq-var-dart.conf

require conf/machine/include/debianbasics.inc
```

## conf/machine/imx8qm-var-som-debian.conf
```bitbake
MACHINE="imx8qm-var-som"
require conf/machine/imx8qm-var-som.conf

require conf/machine/include/debianbasics.inc
```

## conf/machine/imx8qxp-var-som-debian.conf
```bitbake
MACHINE="imx8qxp-var-som"
require conf/machine/imx8qxp-var-som.conf

require conf/machine/include/debianbasics.inc
```

## conf/machine/imx93-var-som-debian.conf
```bitbake
MACHINE="imx93-var-som"
require conf/machine/imx93-var-som.conf

require conf/machine/include/debianbasics.inc
```
